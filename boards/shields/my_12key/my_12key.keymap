#include <dt-bindings/zmk/behavior.h>

/ {
	keymap {
		compatible = "zmk,keymap";

		default_layer {
			bindings = <
				&kp W        /*0*/
				&kp A        /*1*/
				&kp S        /*2*/
				&kp D        /*3*/
				&kp SPACE    /*4*/
				&kp F        /*5*/
				&kp E        /*6*/
				&kp UP       /*7*/
				&kp DOWN     /*8*/
				&kp R        /*9*/
				&kp LALT     /*10*/
				&kp TAB      /*11 TAB*/
			>;
		};
	};
};
