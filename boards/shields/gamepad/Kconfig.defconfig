## boards/shields/gamepad/Kconfig.defconfig
```kconfig
if SHIELD_GAMEPAD

config ZMK_KEYBOARD_NAME
    default "Gamepad"

# 开启蓝牙、USB键盘必需开关
config USB_DEVICE_STACK
    default y
config BT_HCI
    default y
config ZMK_BLE
    default y

endif
```

## boards/shields/gamepad/Kconfig.shield
```kconfig
# SPDX-License-Identifier: MIT
config SHIELD_GAMEPAD
    def_bool $(shield_enabled)
    help
        12键游戏手柄自定义Shield
```

## boards/shields/my_12key/Kconfig.shield
```kconfig
config SHIELD_MY12KEY
        bool "my12key 12gpio conductive rubber shield"
        select ZMK_KSCAN_GPIO_KEYS
```

## boards/shields/mykeyboard/Kconfig.defconfig
```kconfig
if SHIELD_MYKEYBOARD

config ZMK_KEYBOARD
    default y

config ZMK_KEYMAP_NAME
    default "mykeyboard"

endif
```

## boards/shields/mykeyboard/mykeyboard.defconfig
```kconfig
CONFIG_ZMK_KEYBOARD_NAME="Mykeyboard"
CONFIG_ZMK_SLEEP=y
CONFIG_PM_STATE_LOCKUP_ENABLE=y
CONFIG_GPIO_AS_PINRESET=y
```

## config/Kconfig.defconfig
```kconfig
if SHIELD_NICE_GAMEPAD

config ZMK_KEYBOARD_NAME
    default "NiceNano‑Gamepad"

config ZMK_BLE
    default y

config ZMK_USB
    default y

# 低功耗优化
config ZMK_BLE_ADV_INTERVAL_MIN
    default 0x0020
config ZMK_BLE_ADV_INTERVAL_MAX
    default 0x0030

config ZMK_IDLE_SLEEP_TIMEOUT
    default 30000

config ZMK_BLE_TX_POWER
    default 0

endif
```

## config/Kconfig.shield
```kconfig
config SHIELD_NICE_GAMEPAD
    bool "NiceNano Gamepad 12keys"
    select ZMK_KSCAN_GPIO_DRIVER
```

## config/boards/shields/nice12/Kconfig.defconfig
```kconfig
if SHIELD_NICE12

config ZMK_KEYBOARD
    default y

config ZMK_KEYMAP_NAME
    default "nice12"

endif
```

## config/boards/shields/nice12/nice12.defconfig
```kconfig
CONFIG_ZMK_KEYBOARD_NAME="Nice12"
CONFIG_ZMK_SLEEP=y
CONFIG_PM_STATE_LOCKUP_ENABLE=y
CONFIG_GPIO_AS_PINRESET=y
```

## config/boards/shields/promicro_12key/Kconfig.defconfig
```kconfig
if SHIELD_PROMICRO_12KEY

config ZMK_KEYBOARD_NAME
	default "12key‑gamepad"

endif
```

## config/west.yml
```yaml
manifest:
  remotes:
    - name: zmkfirmware
      url-base: https://github.com/zmkfirmware
  projects:
    - name: zmk
      remote: zmkfirmware
      revision: v0.14.0   # ✅把原来main改为v0.14.0
      import: app/west.yml
  self:
    path: config
```
