#include <dt-bindings/gpio/gpio.h>
#include <dt-bindings/zmk/keys.h>

/ {
    kscan_direct: kscan-direct {
        compatible = "zmk,kscan-gpio-direct";
        // 关键修复：告诉ZMK一共12个按键
        zmk,matrix-transform = <MATRIX_TRANSFORM_DIRECT(12)>;
        debounce-press-ms = <10>;
        debounce-release-ms = <18>;
        poll-period-ms = <10>;

        input-gpios =
            //1 W
            <&gpio0 17 (GPIO_ACTIVE_LOW | GPIO_PULL_UP)>,
            //2 A
            <&gpio0 20 (GPIO_ACTIVE_LOW | GPIO_PULL_UP)>,
            //3 S
            <&gpio0 22 (GPIO_ACTIVE_LOW | GPIO_PULL_UP)>,
            //4 D
            <&gpio0 24 (GPIO_ACTIVE_LOW | GPIO_PULL_UP)>,
            //5 空格 SPACE
            <&gpio0 09 (GPIO_ACTIVE_LOW | GPIO_PULL_UP)>,
            //6 F
            <&gpio1 04 (GPIO_ACTIVE_LOW | GPIO_PULL_UP)>,
            //7 E
            <&gpio0 10 (GPIO_ACTIVE_LOW | GPIO_PULL_UP)>,
            //8 上方向 UP
            <&gpio0 11 (GPIO_ACTIVE_LOW | GPIO_PULL_UP)>,
            //9 下方向 DOWN
            <&gpio1 11 (GPIO_ACTIVE_LOW | GPIO_PULL_UP)>,
            //10 R
            <&gpio1 00 (GPIO_ACTIVE_LOW | GPIO_PULL_UP)>,
            //11 ALT
            <&gpio1 06 (GPIO_ACTIVE_LOW | GPIO_PULL_UP)>,
            //12 TAB
            <&gpio1 13 (GPIO_ACTIVE_LOW | GPIO_PULL_UP)>;
    };

    // 必须放在根节点下，ZMK才能识别layouts
    keymap {
        compatible = "zmk,keymap";
        default_layer {
            bindings =
                &kp W,
                &kp A,
                &kp S,
                &kp D,
                &kp SPACE,
                &kp F,
                &kp E,
                &kp UP,
                &kp DOWN,
                &kp R,
                &kp LALT,
                &kp TAB;
        };
    };
};
